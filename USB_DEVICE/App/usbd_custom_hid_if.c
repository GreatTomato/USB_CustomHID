/* USER CODE BEGIN Header */
/**
  ******************************************************************************
  * @file           : usbd_custom_hid_if.c
  * @version        : v1.0_Cube
  * @brief          : USB Device Custom HID interface file.
  ******************************************************************************
  * @attention
  *
  * Copyright (c) 2025 STMicroelectronics.
  * All rights reserved.
  *
  * This software is licensed under terms that can be found in the LICENSE file
  * in the root directory of this software component.
  * If no LICENSE file comes with this software, it is provided AS-IS.
  *
  ******************************************************************************
  */
/* USER CODE END Header */

/* Includes ------------------------------------------------------------------*/
#include "usbd_custom_hid_if.h"

/* USER CODE BEGIN INCLUDE */

/* USER CODE END INCLUDE */

/* Private typedef -----------------------------------------------------------*/
/* Private define ------------------------------------------------------------*/
/* Private macro -------------------------------------------------------------*/

/* USER CODE BEGIN PV */
/* Private variables ---------------------------------------------------------*/
uint8_t *receivedData;
/* USER CODE END PV */

/** @addtogroup STM32_USB_OTG_DEVICE_LIBRARY
  * @brief Usb device.
  * @{
  */

/** @addtogroup USBD_CUSTOM_HID
  * @{
  */

/** @defgroup USBD_CUSTOM_HID_Private_TypesDefinitions USBD_CUSTOM_HID_Private_TypesDefinitions
  * @brief Private types.
  * @{
  */

/* USER CODE BEGIN PRIVATE_TYPES */


/*  Undefine default defenition generated by CubeIDE  */
#undef USBD_CUSTOM_HID_REPORT_DESC_SIZE
#define USBD_CUSTOM_HID_REPORT_DESC_SIZE


/* USER CODE END PRIVATE_TYPES */

/**
  * @}
  */

/** @defgroup USBD_CUSTOM_HID_Private_Defines USBD_CUSTOM_HID_Private_Defines
  * @brief Private defines.
  * @{
  */

/* USER CODE BEGIN PRIVATE_DEFINES */

/* USER CODE END PRIVATE_DEFINES */

/**
  * @}
  */

/** @defgroup USBD_CUSTOM_HID_Private_Macros USBD_CUSTOM_HID_Private_Macros
  * @brief Private macros.
  * @{
  */

/* USER CODE BEGIN PRIVATE_MACRO */

/* USER CODE END PRIVATE_MACRO */

/**
  * @}
  */

/** @defgroup USBD_CUSTOM_HID_Private_Variables USBD_CUSTOM_HID_Private_Variables
  * @brief Private variables.
  * @{
  */

/** Usb HID report descriptor. */
__ALIGN_BEGIN static uint8_t CUSTOM_HID_ReportDesc_FS[USBD_CUSTOM_HID_REPORT_DESC_SIZE] __ALIGN_END =
{
  /* USER CODE BEGIN 0 */
#ifdef JOYSTICK_CONF_SLEEP_OS_BUTTON_ENABLED
	    0x05, 0x01,                    // USAGE_PAGE (Generic Desktop)
	    0x09, 0x00,                    // USAGE (Undefined)
	    0xa1, 0x02,                    // COLLECTION (Logical)
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	    0xc0,                          // END_COLLECTION
#endif
#ifdef JOYSTICK_CONF_MULTIMEDIA_KEYS_ENABLED
	    0x05, 0x0c,                    // USAGE_PAGE (Consumer Devices)
	    0x09, 0x01,                    // USAGE (Consumer Control)
	    0xa1, 0x01,                    // COLLECTION (Application)
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	    0xc0,                          // END_COLLECTION
#endif
#ifdef JOYSTICK_CONF_MOUSE_ENABLED
	    0x05, 0x01,                    // USAGE_PAGE (Generic Desktop)
	    0x09, 0x02,                    // USAGE (Mouse)
	    0xa1, 0x01,                    // COLLECTION (Application)
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	    0xc0,                          // END_COLLECTION
#endif
#ifdef JOYSTICK_CONF_DATA_TRANSFER_ENABLED
	    0x06, 0x00, 0xff,              // USAGE_PAGE (Vendor Defined Page 1)
	    0x09, 0x01,                    // USAGE (Vendor Usage  1)
	    0xa1, 0x01,                    // COLLECTION (Application)
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	    0x81, 0x02,                    //   INPUT (Data,Var,Abs)
	    0xc0                           // END_COLLECTION
#endif
  /* USER CODE END 0 */
//  0xC0    /*     END_COLLECTION	             */
};

/* USER CODE BEGIN PRIVATE_VARIABLES */

/* USER CODE END PRIVATE_VARIABLES */

/**
  * @}
  */

/** @defgroup USBD_CUSTOM_HID_Exported_Variables USBD_CUSTOM_HID_Exported_Variables
  * @brief Public variables.
  * @{
  */
extern USBD_HandleTypeDef hUsbDeviceFS;

/* USER CODE BEGIN EXPORTED_VARIABLES */

/* USER CODE END EXPORTED_VARIABLES */
/**
  * @}
  */

/** @defgroup USBD_CUSTOM_HID_Private_FunctionPrototypes USBD_CUSTOM_HID_Private_FunctionPrototypes
  * @brief Private functions declaration.
  * @{
  */

static int8_t CUSTOM_HID_Init_FS(void);
static int8_t CUSTOM_HID_DeInit_FS(void);
static int8_t CUSTOM_HID_OutEvent_FS(uint8_t event_idx, uint8_t state);

/**
  * @}
  */

USBD_CUSTOM_HID_ItfTypeDef USBD_CustomHID_fops_FS =
{
  CUSTOM_HID_ReportDesc_FS,
  CUSTOM_HID_Init_FS,
  CUSTOM_HID_DeInit_FS,
  CUSTOM_HID_OutEvent_FS
};

/** @defgroup USBD_CUSTOM_HID_Private_Functions USBD_CUSTOM_HID_Private_Functions
  * @brief Private functions.
  * @{
  */

/* Private functions ---------------------------------------------------------*/

/**
  * @brief  Initializes the CUSTOM HID media low layer
  * @retval USBD_OK if all operations are OK else USBD_FAIL
  */
static int8_t CUSTOM_HID_Init_FS(void)
{
  /* USER CODE BEGIN 4 */
  return (USBD_OK);
  /* USER CODE END 4 */
}

/**
  * @brief  DeInitializes the CUSTOM HID media low layer
  * @retval USBD_OK if all operations are OK else USBD_FAIL
  */
static int8_t CUSTOM_HID_DeInit_FS(void)
{
  /* USER CODE BEGIN 5 */
  return (USBD_OK);
  /* USER CODE END 5 */
}

/**
  * @brief  Manage the CUSTOM HID class events
  * @param  event_idx: Event index
  * @param  state: Event state
  * @retval USBD_OK if all operations are OK else USBD_FAIL
  */
static int8_t CUSTOM_HID_OutEvent_FS(uint8_t event_idx, uint8_t state)
{
  /* USER CODE BEGIN 6 */
  UNUSED(event_idx);
  UNUSED(state);

  //Get pointer to received data (1 byte ID, 63 byte data)
  USBD_CUSTOM_HID_HandleTypeDef *hhid =
          (USBD_CUSTOM_HID_HandleTypeDef *)hUsbDeviceFS.pClassData;

      if (hhid == NULL) {
          return -1; // Handle error case
      }

      // Pointer to received data buffer
      receivedData = hhid->Report_buf;

  if (receivedData[0]) {}
  /* Start next USB packet transfer once data processing is completed */
  if (USBD_CUSTOM_HID_ReceivePacket(&hUsbDeviceFS) != (uint8_t)USBD_OK)
  {
    return -1;
  }

  return (USBD_OK);
  /* USER CODE END 6 */
}

/* USER CODE BEGIN 7 */

/**
  * @brief  Send the report to the Host
  * @param  report: The report to be sent
  * @param  len: The report length
  * @retval USBD_OK if all operations are OK else USBD_FAIL
  */
/*
static int8_t USBD_CUSTOM_HID_SendReport_FS(uint8_t *report, uint16_t len)
{
  return USBD_CUSTOM_HID_SendReport(&hUsbDeviceFS, report, len);
}
*/

void Send_Sleep_Report(uint8_t key_state) {
    uint8_t report[2] = {0x0A, key_state}; // Report ID 8 and key state (0x01 for press, 0x00 for release)
    USBD_CUSTOM_HID_SendReport(&hUsbDeviceFS, report, sizeof(report));  // Send the report
}
void Send_Data_ReportTest() {

	  if (hUsbDeviceFS.dev_state == USBD_STATE_CONFIGURED)
	  {
	  uint8_t report[0x20];
	  report[0] = 0xFF;  // Report ID (if not using multiple IDs)
	  report[1] = 0x00;  // Example data
	  report[2] = 0x01;  // Example data
	  report[3] = 0x02;  // Example data
	  report[4] = 0x03;  // Example data
	  report[5] = 0x04;  // Example data
	  USBD_CUSTOM_HID_SendReport(&hUsbDeviceFS, report, sizeof(report));
	     }
}
void Send_MouseReport(volatile uint8_t *mouseDescriptionArray) {
    uint8_t report[] = {0x0B, mouseDescriptionArray[0], mouseDescriptionArray[1], mouseDescriptionArray[2], mouseDescriptionArray[3]}; // Report ID 8 and key state (0x01 for press, 0x00 for release)
    USBD_CUSTOM_HID_SendReport(&hUsbDeviceFS, report, sizeof(report));  // Send the report
}

void ReceivePacket(uint8_t key_state) {
    uint8_t report[2] = {0x0A, key_state}; // Report ID 8 and key state (0x01 for press, 0x00 for release)
    USBD_CUSTOM_HID_SendReport(&hUsbDeviceFS, report, sizeof(report));  // Send the report
}

/* USER CODE END 7 */

/* USER CODE BEGIN PRIVATE_FUNCTIONS_IMPLEMENTATION */

/* USER CODE END PRIVATE_FUNCTIONS_IMPLEMENTATION */
/**
  * @}
  */

/**
  * @}
  */

/**
  * @}
  */

